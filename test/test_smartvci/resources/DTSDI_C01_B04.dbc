VERSION ""

NS_ :

BS_:

BU_: DTS_Tester DTS_Boards
VAL_TABLE_ DTSDI_Channel_Status 1 "True" 0 "False" ;

BO_ 2147537172 DTSDI_C01_B02_Query: 8 DTS_Boards
 SG_ DTSDI_Channel_01_Status : 0|1@0+ (1,0) [0|1] "" Vector__XXX
 SG_ DTSDI_Channel_02_Status : 1|1@0+ (1,0) [0|1] "" Vector__XXX
 SG_ DTSDI_Channel_03_Status : 2|1@0+ (1,0) [0|1] "" Vector__XXX
 SG_ DTSDI_Channel_04_Status : 3|1@0+ (1,0) [0|1] "" Vector__XXX
 SG_ DTSDI_Channel_05_Status : 4|1@0+ (1,0) [0|1] "" Vector__XXX
 SG_ DTSDI_Channel_06_Status : 5|1@0+ (1,0) [0|1] "" Vector__XXX
 SG_ DTSDI_Channel_07_Status : 6|1@0+ (1,0) [0|1] "" Vector__XXX
 SG_ DTSDI_Channel_08_Status : 7|1@0+ (1,0) [0|1] "" Vector__XXX
 SG_ DTSDI_Channel_09_Status : 8|1@0+ (1,0) [0|1] "" Vector__XXX
 SG_ DTSDI_Channel_10_Status : 9|1@0+ (1,0) [0|1] "" Vector__XXX
 SG_ DTSDI_Channel_11_Status : 10|1@0+ (1,0) [0|1] "" Vector__XXX
 SG_ DTSDI_Channel_12_Status : 11|1@0+ (1,0) [0|1] "" Vector__XXX
 SG_ DTSDI_Channel_13_Status : 12|1@0+ (1,0) [0|1] "" Vector__XXX
 SG_ DTSDI_Channel_14_Status : 13|1@0+ (1,0) [0|1] "" Vector__XXX
 SG_ DTSDI_Channel_15_Status : 14|1@0+ (1,0) [0|1] "" Vector__XXX
 SG_ DTSDI_Channel_16_Status : 15|1@0+ (1,0) [0|1] "" Vector__XXX
 SG_ DTSDI_Channel_17_Status : 16|1@0+ (1,0) [0|1] "" Vector__XXX
 SG_ DTSDI_Channel_18_Status : 17|1@0+ (1,0) [0|1] "" Vector__XXX
 SG_ DTSDI_Channel_19_Status : 18|1@0+ (1,0) [0|1] "" Vector__XXX
 SG_ DTSDI_Channel_20_Status : 19|1@0+ (1,0) [0|1] "" Vector__XXX
 SG_ DTSDI_Channel_21_Status : 20|1@0+ (1,0) [0|1] "" Vector__XXX
 SG_ DTSDI_Channel_22_Status : 21|1@0+ (1,0) [0|1] "" Vector__XXX
 SG_ DTSDI_Channel_23_Status : 22|1@0+ (1,0) [0|1] "" Vector__XXX
 SG_ DTSDI_Channel_24_Status : 23|1@0+ (1,0) [0|1] "" Vector__XXX
 SG_ DTSDI_Channel_25_Status : 24|1@0+ (1,0) [0|1] "" Vector__XXX
 SG_ DTSDI_Channel_26_Status : 25|1@0+ (1,0) [0|1] "" Vector__XXX
 SG_ DTSDI_Channel_27_Status : 26|1@0+ (1,0) [0|1] "" Vector__XXX
 SG_ DTSDI_Channel_28_Status : 27|1@0+ (1,0) [0|1] "" Vector__XXX
 SG_ DTSDI_Channel_29_Status : 28|1@0+ (1,0) [0|1] "" Vector__XXX
 SG_ DTSDI_Channel_30_Status : 29|1@0+ (1,0) [0|1] "" Vector__XXX

BA_DEF_  "BusType" STRING ;
BA_DEF_DEF_  "BusType" "CAN";
VAL_ 2147537172 DTSDI_Channel_01_Status 1 "True" 0 "False" ;
VAL_ 2147537172 DTSDI_Channel_02_Status 1 "True" 0 "False" ;
VAL_ 2147537172 DTSDI_Channel_03_Status 1 "True" 0 "False" ;
VAL_ 2147537172 DTSDI_Channel_04_Status 1 "True" 0 "False" ;
VAL_ 2147537172 DTSDI_Channel_05_Status 1 "True" 0 "False" ;
VAL_ 2147537172 DTSDI_Channel_06_Status 1 "True" 0 "False" ;
VAL_ 2147537172 DTSDI_Channel_07_Status 1 "True" 0 "False" ;
VAL_ 2147537172 DTSDI_Channel_08_Status 1 "True" 0 "False" ;
VAL_ 2147537172 DTSDI_Channel_09_Status 1 "True" 0 "False" ;
VAL_ 2147537172 DTSDI_Channel_10_Status 1 "True" 0 "False" ;
VAL_ 2147537172 DTSDI_Channel_11_Status 1 "True" 0 "False" ;
VAL_ 2147537172 DTSDI_Channel_12_Status 1 "True" 0 "False" ;
VAL_ 2147537172 DTSDI_Channel_13_Status 1 "True" 0 "False" ;
VAL_ 2147537172 DTSDI_Channel_14_Status 1 "True" 0 "False" ;
VAL_ 2147537172 DTSDI_Channel_15_Status 1 "True" 0 "False" ;
VAL_ 2147537172 DTSDI_Channel_16_Status 1 "True" 0 "False" ;
VAL_ 2147537172 DTSDI_Channel_17_Status 1 "True" 0 "False" ;
VAL_ 2147537172 DTSDI_Channel_18_Status 1 "True" 0 "False" ;
VAL_ 2147537172 DTSDI_Channel_19_Status 1 "True" 0 "False" ;
VAL_ 2147537172 DTSDI_Channel_20_Status 1 "True" 0 "False" ;
VAL_ 2147537172 DTSDI_Channel_21_Status 1 "True" 0 "False" ;
VAL_ 2147537172 DTSDI_Channel_22_Status 1 "True" 0 "False" ;
VAL_ 2147537172 DTSDI_Channel_23_Status 1 "True" 0 "False" ;
VAL_ 2147537172 DTSDI_Channel_24_Status 1 "True" 0 "False" ;
VAL_ 2147537172 DTSDI_Channel_25_Status 1 "True" 0 "False" ;
VAL_ 2147537172 DTSDI_Channel_26_Status 1 "True" 0 "False" ;
VAL_ 2147537172 DTSDI_Channel_27_Status 1 "True" 0 "False" ;
VAL_ 2147537172 DTSDI_Channel_28_Status 1 "True" 0 "False" ;
VAL_ 2147537172 DTSDI_Channel_29_Status 1 "True" 0 "False" ;
VAL_ 2147537172 DTSDI_Channel_30_Status 1 "True" 0 "False" ;
